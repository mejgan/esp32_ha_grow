## main/Kconfig.projbuild
```kconfig
menu "Grow Box"

    menu "Floor 1 pins (DHT11, capacitive soil, LED strip 1)"
        config GROWBOX_F1_DHT11_GPIO
            int "DHT11 DATA GPIO"
            default 18

        config GROWBOX_F1_SOIL_CAP_GPIO
            int "Capacitive soil sensor AOUT GPIO (ADC1: 0-5)"
            range 0 5
            default 0

        config GROWBOX_F1_LIGHT_PWM_GPIO
            int "LED strip 1 PWM GPIO (IRF520 SIG)"
            default 19
    endmenu

    menu "Floor 2 pins (AHT10 #1, YL-69 soil, LED strip 2)"
        comment "AHT10 #1 uses the LP I2C bus, fixed to SDA=GPIO6, SCL=GPIO7"

        config GROWBOX_F2_SOIL_RES_GPIO
            int "YL-69/FC-28 module AO GPIO (ADC1: 0-5)"
            range 0 5
            default 1

        config GROWBOX_F2_SOIL_RES_PWR_GPIO
            int "YL-69/FC-28 module VCC GPIO"
            default 10
            help
                Powered only during a read to slow down probe corrosion.

        config GROWBOX_F2_LIGHT_PWM_GPIO
            int "LED strip 2 PWM GPIO (IRF520 SIG)"
            default 20
    endmenu

    menu "Floor 3 pins (AHT10 #2, BMP180, TEMT6000, LED strip 3)"
        config GROWBOX_F3_I2C_SDA_GPIO
            int "I2C SDA GPIO (AHT10 #2, BMP180)"
            default 22

        config GROWBOX_F3_I2C_SCL_GPIO
            int "I2C SCL GPIO (AHT10 #2, BMP180)"
            default 23

        config GROWBOX_F3_LIGHT_SENSOR_GPIO
            int "TEMT6000 SIG GPIO (ADC1: 0-5)"
            range 0 5
            default 2

        config GROWBOX_F3_LIGHT_PWM_GPIO
            int "LED strip 3 PWM GPIO (IRF520 SIG)"
            default 21
    endmenu

    config GROWBOX_SENSOR_PERIOD_S
        int "Sensor read period (s)"
        range 5 3600
        default 30

    config GROWBOX_PWM_FREQ_HZ
        int "LED PWM frequency (Hz)"
        range 100 20000
        default 1000

    menu "Soil sensor calibration"
        config GROWBOX_SOIL_CAP_DRY_MV
            int "Capacitive sensor reading in dry air (mV)"
            default 2700
            help
                Read the logged mV in dry air / in water and set these.

        config GROWBOX_SOIL_CAP_WET_MV
            int "Capacitive sensor reading in water (mV)"
            default 1300
            help
                Read the logged mV in dry air / in water and set these.

        config GROWBOX_SOIL_RES_DRY_MV
            int "YL-69 reading in dry air (mV)"
            default 3200
            help
                Read the logged mV in dry air / in water and set these.

        config GROWBOX_SOIL_RES_WET_MV
            int "YL-69 reading in water (mV)"
            default 1000
            help
                Read the logged mV in dry air / in water and set these.
    endmenu

    menu "Default settings (first boot, every floor)"
        config GROWBOX_DEFAULT_ON_HOUR
            int "Light on hour"
            range 0 23
            default 6

        config GROWBOX_DEFAULT_OFF_HOUR
            int "Light off hour"
            range 0 23
            default 0

        config GROWBOX_DEFAULT_BRIGHTNESS
            int "Auto mode brightness (%)"
            range 1 100
            default 100

        config GROWBOX_DEFAULT_MAX_TEMP
            int "Over-temperature cutoff (C)"
            range 20 50
            default 35
    endmenu

    config GROWBOX_TEMP_FAILSAFE_MIN
        int "Light off after this many minutes without any temperature reading (0 = never)"
        range 0 1440
        default 10
        help
            If no temperature sensor gives a reading for this long, the over-temperature cutoff of every enabled
            floor engages (light off) until a reading is back. A floor without its own reading uses the hottest
            other floor first, so this only happens when all temperature sensors fail.

    menu "Room sensor (next to the controller, outside the grow box)"
        choice GROWBOX_ROOM
            prompt "Room temperature / humidity sensor"
            default GROWBOX_ROOM_NONE
            help
                Shown in Zigbee2MQTT as temperature_room / humidity_room (endpoint 4), like a plain Zigbee
                climate sensor, and on the display. Not used for the over-temperature cutoff.

            config GROWBOX_ROOM_NONE
                bool "None"
            config GROWBOX_ROOM_DHT22
                bool "DHT22 / AM2302 (one-wire GPIO)"
            config GROWBOX_ROOM_DHT11
                bool "DHT11 (one-wire GPIO)"
            config GROWBOX_ROOM_SHT3X
                bool "SHT30 / SHT31 / SHT35 (I2C 0x44 or 0x45)"
            config GROWBOX_ROOM_SHT4X
                bool "SHT40 / SHT41 / SHT45 (I2C 0x44)"
            config GROWBOX_ROOM_HTU21D
                bool "HTU21D / SHT21 / Si7021 (I2C 0x40)"
            config GROWBOX_ROOM_BME280
                bool "BME280 (I2C 0x76), adds pressure; a BMP280 gives temperature + pressure only"
        endchoice

        config GROWBOX_ROOM_DHT
            bool
            default y if GROWBOX_ROOM_DHT22 || GROWBOX_ROOM_DHT11

        config GROWBOX_ROOM_I2C
            bool
            default y if GROWBOX_ROOM_SHT3X || GROWBOX_ROOM_SHT4X || GROWBOX_ROOM_HTU21D || GROWBOX_ROOM_BME280

        config GROWBOX_ROOM_GPIO
            int "Data GPIO (10 kOhm pull-up to 3V3)"
            depends on GROWBOX_ROOM_DHT
            default 15

        choice GROWBOX_ROOM_I2C_BUS
            prompt "I2C bus"
            depends on GROWBOX_ROOM_I2C
            default GROWBOX_ROOM_I2C_BUS_MAIN

            config GROWBOX_ROOM_I2C_BUS_MAIN
                bool "Floor 3 sensor bus (floor 3 SDA/SCL pins)"
            config GROWBOX_ROOM_I2C_BUS_LP
                bool "LP I2C bus (GPIO6 SDA, GPIO7 SCL)"
        endchoice

        config GROWBOX_ROOM_I2C_ADDR
            hex "I2C address"
            depends on GROWBOX_ROOM_I2C
            range 0x08 0x77
            default 0x44 if GROWBOX_ROOM_SHT3X || GROWBOX_ROOM_SHT4X
            default 0x40 if GROWBOX_ROOM_HTU21D
            default 0x76
            help
                The AHT10s (0x38) and the BMP180 (0x77) are already on the sensor buses, so a BME280 must use
                0x76 (SDO to GND) and an AHT10/AHT20 cannot be the room sensor.
    endmenu

    menu "Display"
        choice GROWBOX_DISPLAY
            prompt "Display type"
            default GROWBOX_DISPLAY_NONE

            config GROWBOX_DISPLAY_NONE
                bool "None"
            config GROWBOX_DISPLAY_SSD1306_128X64
                bool "SSD1306 OLED 0.96\" 128x64 (I2C)"
            config GROWBOX_DISPLAY_SSD1306_128X32
                bool "SSD1306 OLED 0.91\" 128x32 (I2C)"
            config GROWBOX_DISPLAY_SH1106_128X64
                bool "SH1106 OLED 1.3\" 128x64 (I2C)"
            config GROWBOX_DISPLAY_HD44780_1602
                bool "HD44780 16x2 character LCD with PCF8574 I2C backpack"
            config GROWBOX_DISPLAY_HD44780_2004
                bool "HD44780 20x4 character LCD with PCF8574 I2C backpack"
            config GROWBOX_DISPLAY_ST7789
                bool "ST7789 color TFT (SPI)"
            config GROWBOX_DISPLAY_ILI9341
                bool "ILI9341 color TFT (SPI)"
        endchoice

        config GROWBOX_DISPLAY_OLED
            bool
            default y if GROWBOX_DISPLAY_SSD1306_128X64 || GROWBOX_DISPLAY_SSD1306_128X32 || GROWBOX_DISPLAY_SH1106_128X64

        config GROWBOX_DISPLAY_LCD
            bool
            default y if GROWBOX_DISPLAY_HD44780_1602 || GROWBOX_DISPLAY_HD44780_2004

        config GROWBOX_DISPLAY_TFT
            bool
            default y if GROWBOX_DISPLAY_ST7789 || GROWBOX_DISPLAY_ILI9341

        config GROWBOX_DISPLAY_I2C
            bool
            default y if GROWBOX_DISPLAY_OLED || GROWBOX_DISPLAY_LCD

        choice GROWBOX_DISPLAY_I2C_BUS
            prompt "I2C bus"
            depends on GROWBOX_DISPLAY_I2C
            default GROWBOX_DISPLAY_I2C_BUS_MAIN
            help
                The display shares a sensor I2C bus, so it needs no extra pins.

            config GROWBOX_DISPLAY_I2C_BUS_MAIN
                bool "Floor 3 sensor bus (floor 3 SDA/SCL pins)"
            config GROWBOX_DISPLAY_I2C_BUS_LP
                bool "LP I2C bus (GPIO6 SDA, GPIO7 SCL)"
        endchoice

        config GROWBOX_DISPLAY_I2C_ADDR
            hex "I2C address (0 = auto-detect)"
            depends on GROWBOX_DISPLAY_I2C
            range 0x0 0x7f
            default 0x0
            help
                Auto-detect tries 0x3C/0x3D for OLEDs and 0x27/0x3F (and the rest of 0x20-0x27, 0x38-0x3F)
                for PCF8574 LCD backpacks.

        config GROWBOX_DISPLAY_I2C_HZ
            int "I2C clock (Hz)"
            depends on GROWBOX_DISPLAY_I2C
            range 10000 1000000
            default 400000 if GROWBOX_DISPLAY_OLED
            default 100000

        config GROWBOX_DISPLAY_OLED_FLIP
            bool "Rotate OLED 180 degrees"
            depends on GROWBOX_DISPLAY_OLED
            default n

        config GROWBOX_DISPLAY_OLED_CONTRAST
            int "OLED contrast"
            depends on GROWBOX_DISPLAY_OLED
            range 0 255
            default 127

        config GROWBOX_DISPLAY_SPI_SCLK_GPIO
            int "SPI SCLK (SCL/SCK) GPIO"
            depends on GROWBOX_DISPLAY_TFT
            default 4

        config GROWBOX_DISPLAY_SPI_MOSI_GPIO
            int "SPI MOSI (SDA/DIN) GPIO"
            depends on GROWBOX_DISPLAY_TFT
            default 5

        config GROWBOX_DISPLAY_SPI_CS_GPIO
            int "CS GPIO (-1 if the module has no CS pin)"
            depends on GROWBOX_DISPLAY_TFT
            default 11

        config GROWBOX_DISPLAY_SPI_DC_GPIO
            int "DC (RS/A0) GPIO"
            depends on GROWBOX_DISPLAY_TFT
            default 3

        config GROWBOX_DISPLAY_SPI_RST_GPIO
            int "RST GPIO (-1 = tie RST to 3V3)"
            depends on GROWBOX_DISPLAY_TFT
            default -1

        config GROWBOX_DISPLAY_BL_GPIO
            int "Backlight GPIO (-1 = backlight wired to 3V3)"
            depends on GROWBOX_DISPLAY_TFT
            default -1

        config GROWBOX_DISPLAY_SPI_MODE
            int "SPI mode (3 for ST7789 modules without CS)"
            depends on GROWBOX_DISPLAY_TFT
            range 0 3
            default 0

        config GROWBOX_DISPLAY_SPI_HZ
            int "SPI clock (Hz)"
            depends on GROWBOX_DISPLAY_TFT
            range 1000000 80000000
            default 40000000

        config GROWBOX_DISPLAY_WIDTH
            int "Panel width in pixels (portrait)"
            depends on GROWBOX_DISPLAY_TFT
            range 64 480
            default 240

        config GROWBOX_DISPLAY_HEIGHT
            int "Panel height in pixels (portrait)"
            depends on GROWBOX_DISPLAY_TFT
            range 64 480
            default 320

        config GROWBOX_DISPLAY_ROTATION
            int "Rotation (0-3, quarter turns; 1 and 3 = landscape)"
            depends on GROWBOX_DISPLAY_TFT
            range 0 3
            default 0

        config GROWBOX_DISPLAY_X_OFFSET
            int "Column offset after rotation (e.g. 52 for 135x240 ST7789)"
            depends on GROWBOX_DISPLAY_TFT
            range 0 240
            default 0

        config GROWBOX_DISPLAY_Y_OFFSET
            int "Row offset after rotation (e.g. 80 for 240x240 ST7789 rotated 180)"
            depends on GROWBOX_DISPLAY_TFT
            range 0 240
            default 0

        config GROWBOX_DISPLAY_INVERT
            bool "Invert colors (most ST7789 modules need this)"
            depends on GROWBOX_DISPLAY_TFT
            default y if GROWBOX_DISPLAY_ST7789
            default n

        config GROWBOX_DISPLAY_BGR
            bool "BGR color order (most ILI9341 modules need this)"
            depends on GROWBOX_DISPLAY_TFT
            default y if GROWBOX_DISPLAY_ILI9341
            default n

        config GROWBOX_DISPLAY_FONT_SCALE
            int "Font scale (1 = 6x8 px characters)"
            depends on GROWBOX_DISPLAY_TFT
            range 1 4
            default 2

        config GROWBOX_DISPLAY_PAGE_S
            int "Seconds per page"
            depends on !GROWBOX_DISPLAY_NONE
            range 1 120
            default 5

        config GROWBOX_DISPLAY_TIMEOUT_S
            int "Turn the display off after this many seconds without a button press (0 = always on)"
            depends on !GROWBOX_DISPLAY_NONE
            range 0 86400
            default 0
    endmenu

    menu "Button"
        config GROWBOX_BUTTON_GPIO
            int "Button GPIO, active low (-1 = none)"
            range -1 30
            default 9
            help
                GPIO9 is the BOOT button of ESP32-C6 boards. Short press: next display page (or wake the
                display). Hold: Zigbee factory reset (leave the network and pair again).

        config GROWBOX_BUTTON_RESET_S
            int "Hold time for the Zigbee factory reset (s)"
            depends on GROWBOX_BUTTON_GPIO >= 0
            range 3 60
            default 10
    endmenu

    menu "Zigbee OTA"
        config GROWBOX_OTA_MANUF_CODE
            hex "Manufacturer code in OTA images"
            default 0x131B
            help
                Must match the OTA file (tools/make_ota_image.py uses the same default). 0x131B is Espressif's.

        config GROWBOX_OTA_IMAGE_TYPE
            hex "Image type in OTA images"
            default 0x4742
    endmenu

    config GROWBOX_ZB_CHANNEL_MASK
        hex "Zigbee channel mask"
        default 0x07FFF800
        help
            Bit N set = channel N allowed. Default: all channels 11-26.

endmenu
```
